## main/Kconfig.projbuild
```kconfig
menu "Application settings"

    config DEFAULT_STA_SSID
        string "Default STA SSID (max 20 chars)"
        default "my_wifi"
        help
            SSID of the WiFi network to connect to

    config DEFAULT_STA_PASSWORD
        string "Default STA password (max 20 chars)"
        default "my_password"
        help
            Password of the WiFi network to connect to

    config DEFAULT_AP_SSID
        string "Default AP SSID (max 20 chars)"
        default "ESP32-AP"
        help
            SSID of the access point for configuring the device

    config DEFAULT_AP_PASSWORD
        string "Default AP password (max 20 chars)"
        default "12345678"
        help
            Password of the access point for configuring the device

    choice DEFAULT_WIFI_STARTUP_MODE
        prompt "Default WiFi startup mode"
        default DEFAULT_WIFI_STARTUP_MODE_AP
        help
            Select the default WiFi startup mode.

        config DEFAULT_WIFI_STARTUP_MODE_STA
            bool "STA Mode"
            help
                Start the device in Station (STA) mode.

        config DEFAULT_WIFI_STARTUP_MODE_AP
            bool "AP Mode"
            help
                Start the device in Access Point (AP) mode.

    endchoice

endmenu
```
